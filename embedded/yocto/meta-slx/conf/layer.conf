## embedded/yocto/meta-slx/conf/layer.conf
```bitbake
# Silicon LogiX / SLX SeaBalance
# Copyright (c) 2026 Marco Pezzullo (Silicon LogiX).
# Author: Marco Pezzullo
# License: Silicon LogiX Evaluation License 1.0. See LICENSE.

BBPATH .= ":${LAYERDIR}"
BBFILES += "${LAYERDIR}/recipes-*/*/*.bb ${LAYERDIR}/recipes-*/*/*.bbappend"
BBFILE_COLLECTIONS += "slx"
BBFILE_PATTERN_slx = "^${LAYERDIR}/"
BBFILE_PRIORITY_slx = "8"
LAYERSERIES_COMPAT_slx = "scarthgap"
LAYERDEPENDS_slx = "core st-openstlinux"
```
